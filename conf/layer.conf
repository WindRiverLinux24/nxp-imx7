## conf/layer.conf
```bitbake
#
# Copyright (C) 2022 Wind River Systems, Inc.
#

# We have a conf and classes directory, add to BBPATH
BBPATH =. "${LAYERDIR}:"

# We have a packages directory, add to BBFILES
BBFILES += "${LAYERDIR}/recipes-*/*/*.bb \
        ${LAYERDIR}/recipes-*/*/*.bbappend"

BBFILE_COLLECTIONS += "wr-nxp-imx7"
BBFILE_PATTERN_wr-nxp-imx7 := "^${LAYERDIR}/"
BBFILE_PRIORITY_wr-nxp-imx7 = "7"

BSP_NXP_DERIVED:append:nxp-imx7  = " nxp-imx7"

# This should only be incremented on significant changes that will
# cause compatibility issues with other layers
LAYERVERSION_wr-nxp-imx7 = "1"

LAYERDEPENDS_wr-nxp-imx7 = "core wrlinux freescale-layer freescale-distro fsl-bsp-release fsl-sdk-release"
LAYERSERIES_COMPAT_wr-nxp-imx7 = "wrl mickledore"

WRL_RECIPES:freescale-layer += 'u-boot-imx'
```

## conf/machine/nxp-imx7.conf
```bitbake
#@TYPE: Machine
#@NAME: nxp-imx7
#@DESCRIPTION: Machine configuration for NXP i.MX7
# In order to support the cortexa7 and cortexa9 at the same time

DEFAULTTUNE ?= "armv7athf-neon"

require conf/machine/include/arm/armv7a/tune-cortexa7.inc

MACHINE_FEATURES = "ext3 pci usbgadget usbhost vfat alsa touchscreen profile network"

MACHINEOVERRIDES:prepend:nxp-imx7 = "mx7:mx7d:mx7-generic-bsp:mx7-nxp-bsp:"

KERNEL_IMAGETYPE = "zImage"
DTB_FILES = "imx7d-sdb.dtb imx7d-sdb-epdc.dtb imx7d-sdb-gpmi-weim.dtb \
	     imx7d-sdb-m4.dtb imx7d-sdb-mipi-dsi.dtb imx7d-sdb-qspi.dtb \
	     imx7d-sdb-reva.dtb"

KERNEL_DEVICETREE = "${@''.join('nxp/imx/%s ' % d for d in '${DTB_FILES}'.split())}"

SERIAL_CONSOLE = "115200 ttymxc0"

WKS_FILE ?= "sdimage-ubootheader-imx7.wks"
do_image_wic[depends] += "mtools-native:do_populate_sysroot dosfstools-native:do_populate_sysroot"

MACHINE_EXTRA_RRECOMMENDS = " kernel-modules kernel-devicetree"
IMAGE_FSTYPES += "tar.bz2 wic wic.bmap"
IMAGE_INSTALL:append = " kernel-devicetree kernel-image-zimage"

IMAGE_BOOT_FILES ?= "zImage imx7d-sdb.dtb"

UBOOT_CONFIG = "sd"
UBOOT_CONFIG[sd] = "mx7dsabresd_config,sdcard"

PREFERRED_PROVIDER_virtual/kernel ??= "linux-yocto"
PREFERRED_VERSION_linux-yocto ?= "6.6%"


# The loader is flashed into the device separately and not part of the SD image
OSTREE_BOOTLOADER_INCLUDE ?= ""
OSTREE_SD_UBOOT_WIC1 ?= ""
OSTREE_SD_UBOOT_WIC2 ?= ""
OSTREE_SD_UBOOT_WIC3 ?= ""
OSTREE_SD_UBOOT_WIC4 ?= ""
OSTREE_SD_BOOT_ALIGN ?= "4096"
OSTREE_FDISK_BLM ?= "8192"
OSTREE_UBOOT_CMD ?= "bootz"
INITRAMFS_IMAGE ??= ""
IMAGE_BOOT_FILES:append = " \
    ${@bb.utils.contains('DISTRO_FEATURES', 'ostree', 'boot.scr', '', d)} \
    ${@bb.utils.contains('DISTRO_FEATURES', 'ostree', '${INITRAMFS_IMAGE}-${MACHINE}.${INITRAMFS_FSTYPES};initramfs', '', d)} \
"
OSTREE_KERNEL ?= "zImage"
OSTREE_COPY_IMAGE_BOOT_FILES = "1"
OSTREE_BOOTSCR_PRECMD ?= "\
setenv devnum \${mmcdev}; \
setenv no_menu yes; \
"

# For ustart.img
OSTREE_NETINST_DEV ?= "/dev/mmcblk0,/dev/mmcblk1,/dev/sda,/dev/vda"
OSTREE_NETINST_ARGS ?= " \
    ${OSTREE_CONSOLE} bl=ufsd rdinit=/install \
    instdev=${OSTREE_NETINST_DEV} instname=wrlinux \
    instbr=\$BRANCH insturl=\$URL instab=${OSTREE_USE_AB} \
    instsf=1 instdate=BUILD_DATE \
"
```
